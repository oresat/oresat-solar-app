## boards/mcxn947_solar_card/Kconfig
```kconfig
# Copyright 2024-2025 NXP
# SPDX-License-Identifier: Apache-2.0

config BOARD_MCXN947_SOLAR_CARD
	select BOARD_EARLY_INIT_HOOK
```

## boards/mcxn947_solar_card/Kconfig.mcxn947_solar_card
```kconfig
# Copyright 2024 NXP
# SPDX-License-Identifier: Apache-2.0

config BOARD_MCXN947_SOLAR_CARD
        select SOC_MCXN947_CPU0 if BOARD_MCXN947_SOLAR_CARD_MCXN947_CPU0
        select SOC_MCXN947_CPU1 if BOARD_MCXN947_SOLAR_CARD_MCXN947_CPU1
        select SOC_PART_NUMBER_MCXN947VDF
```

## boards/mcxn947_solar_card/mcxn947_solar_card_mcxn947_cpu0_defconfig
```kconfig
CONFIG_SYS_CLOCK_HW_CYCLES_PER_SEC=150000000
CONFIG_TRUSTED_EXECUTION_SECURE=y
CONFIG_CLOCK_CONTROL=y
CONFIG_SERIAL=y
CONFIG_UART_MCUX_LPUART=y
CONFIG_UART_CONSOLE=y
CONFIG_STDOUT_CONSOLE=y
```

## drivers/sensor/ti/tmp101/Kconfig
```kconfig
# TMP101 temperature sensor configuration options

# Based on zephyr/drivers/sensor/ti/tmp108/Kconfig, originally liscenced under Apache-2.0

menuconfig TMP101
	bool "TMP101 Temperature Sensor"
	default y
	depends on DT_HAS_TI_TMP101_ENABLED
	select I2C

	help
	  Enable driver for the TMP101 temperature sensor.

if TMP101

config TMP101_ALERT_INTERRUPTS
	bool "Allow interrupts to service over and under temp alerts"
	help
	  This will set up interrupts to service under and over temp alerts
	  see TMP101 spec sheet for more information on how these work.

endif # TMP101
```
